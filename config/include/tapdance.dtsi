// vim: set ts=4 sw=4 ft=devicetree:

#include "base.h"

/ {
    behaviors {
        dot_question_colon: dot_question {
            compatible = "zmk,behavior-tap-dance";
            #binding-cells = <0>;
            tapping-term-ms = <400>;
            bindings = <&kp DOT>, <&kp QMARK>;
        };
    };
};